## configs/beaglebone_defconfig
```kconfig
BR2_arm=y
BR2_cortex_a8=y
BR2_JLEVEL=4
BR2_TOOLCHAIN_EXTERNAL=y
BR2_TARGET_GENERIC_HOSTNAME="beaglebone"
BR2_TARGET_ROOTFS_EXT2=y
# BR2_TARGET_ROOTFS_TAR is not set
BR2_TARGET_UBOOT=y
BR2_TARGET_UBOOT_BOARDNAME="am335x_evm"
BR2_TARGET_UBOOT_CUSTOM_GIT=y
BR2_TARGET_UBOOT_CUSTOM_PATCH_DIR="board/ti/beaglebone/u-boot"
BR2_TARGET_UBOOT_CUSTOM_GIT_REPO_URL="git://arago-project.org/git/projects/u-boot-am33x.git"
BR2_TARGET_UBOOT_CUSTOM_GIT_VERSION="f63b270e47f62f4d1a05b2001357e215966c6f5a"
BR2_TARGET_UBOOT_FORMAT_IMG=y
BR2_TARGET_UBOOT_MLO=y
BR2_LINUX_KERNEL=y
BR2_LINUX_KERNEL_CUSTOM_GIT=y
BR2_LINUX_KERNEL_CUSTOM_GIT_REPO_URL="git://github.com/beagleboard/linux.git"
BR2_LINUX_KERNEL_CUSTOM_GIT_VERSION="1d84d8853fa30cf3db2571a5aec572accca4e29d"
BR2_LINUX_KERNEL_PATCH="board/ti/beaglebone/linux"
BR2_LINUX_KERNEL_USE_CUSTOM_CONFIG=y
BR2_LINUX_KERNEL_CUSTOM_CONFIG_FILE="board/ti/linux-ti33x-psp-3.1/beaglebone/defconfig"
```

## configs/beaglebone_uclibc_defconfig
```kconfig
BR2_arm=y
BR2_cortex_a8=y
BR2_JLEVEL=8
BR2_GCC_VERSION_4_5_X=y
BR2_TOOLCHAIN_BUILDROOT_LARGEFILE=y
BR2_TOOLCHAIN_BUILDROOT_LOCALE=y
BR2_TOOLCHAIN_BUILDROOT_CXX=y
BR2_TOOLCHAIN_BUILDROOT_USE_SSP=y
BR2_TARGET_GENERIC_HOSTNAME="beaglebone"
BR2_ROOTFS_DEVICE_CREATION_DYNAMIC_MDEV=y
BR2_TARGET_GENERIC_GETTY_PORT="ttyO0"
# BR2_TARGET_GENERIC_REMOUNT_ROOTFS_RW is not set
BR2_TARGET_ROOTFS_EXT2=y
# BR2_TARGET_ROOTFS_TAR is not set
BR2_TARGET_UBOOT=y
BR2_TARGET_UBOOT_BOARDNAME="am335x_evm"
BR2_TARGET_UBOOT_CUSTOM_GIT=y
BR2_TARGET_UBOOT_CUSTOM_PATCH_DIR="board/ti/beaglebone/u-boot"
BR2_TARGET_UBOOT_CUSTOM_GIT_REPO_URL="git://arago-project.org/git/projects/u-boot-am33x.git"
BR2_TARGET_UBOOT_CUSTOM_GIT_VERSION="f63b270e47f62f4d1a05b2001357e215966c6f5a"
BR2_TARGET_UBOOT_FORMAT_IMG=y
BR2_TARGET_UBOOT_MLO=y
BR2_LINUX_KERNEL=y
BR2_LINUX_KERNEL_CUSTOM_GIT=y
BR2_LINUX_KERNEL_CUSTOM_GIT_REPO_URL="git://github.com/beagleboard/linux.git"
BR2_LINUX_KERNEL_CUSTOM_GIT_VERSION="1d84d8853fa30cf3db2571a5aec572accca4e29d"
BR2_LINUX_KERNEL_PATCH="board/ti/beaglebone/linux"
BR2_LINUX_KERNEL_USE_CUSTOM_CONFIG=y
BR2_LINUX_KERNEL_CUSTOM_CONFIG_FILE="board/ti/beaglebone/kernel_defconfig"
```

## package/erlang/Config.in
```kconfig
config BR2_PACKAGE_ERLANG
	bool "erlang"
	select BR2_PACKAGE_NCURSES
	help
	  Erlang is a functional programming language with support for
	  concurrency, fault-tolerance, and soft real-time.

	  http://www.erlang.org/
```

## package/git/Config.in
```kconfig
config BR2_PACKAGE_GIT
	bool "git"
	select BR2_PACKAGE_OPENSSL
	select BR2_PACKAGE_CURL
	select BR2_PACKAGE_LIBCURL
	select BR2_PACKAGE_ZLIB
	select BR2_PACKAGE_EXPAT
	help
	  Git - the stupid content tracker

	  http://git-scm.com/
```
